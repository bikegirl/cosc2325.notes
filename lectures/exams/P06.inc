
    * What is the difference between assembly code and machine code?

    * What is a directive in assembly language?

    * The Pentium includes code that looks like this: "mov rax, 123". What is
      going on here?

    * The Pentium does not allow any instructions that operate on two memory
      locations. Why is this restriction imposed?


    * What is a "literal" number, and where can it appear in an assembly
      language instruction?

    * Why is it important to define computer languages using formal rules like
      "Backus-Naur Form (BNF)"

    * What is an "Instruction Set Architecture"

    * Many processors use "Microinstructions" to control their operation.
      Basically, what is a microinstruction?

    * What is an "addressing mode"?  Show some typical examples.

    * Typically, we see notation that looks like this: "[name]" in an
      instruction. What does that notation mean?

    * What are "Status Flags" in a processor?

    * How are conditional branching instructions implemented in a processor?

    * Create a table showing the four basic logic operations all computers
      support. (Only one bit data is needed.

    * If an instruction implements an AND logical operation and specified 16
      bit registers, what happens?

    * How is a procedure implemented in a typical processor?

    * What happens when you reach the last instruction in a program?

    * Describe the basic scheme used to encode an instruction into machine code.

    * We can use the AND operation to strip off certain bits in a binary value.
      How does this work?

