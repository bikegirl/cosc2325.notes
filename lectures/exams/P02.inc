
    * Draw a simple Von Neuman machine and explain basically what each part
      does.

    * Explain what the ``base`` of a number system means. 

    * create a table showing the first 16 numbers in Binary, Decimal, and
      Hexadecimal

    * Why do we add a character to the end of numbers indicating the base of
      the system being used?

    * Convert 242d to hexadecimal (hint, go to binary first, and make sure that "d" at the end does not confuse you!)

    * Convert 0fch to decimal (hint, go to binary first. Again, note the "h" at the end, what does that indicate?)

    * How does the computer decide if a memory container contains code or data?

    * We said that memory hold two basic kinds of things in a computer.
      Actually, there are three things possible. What are they? (Hint: you normally throw the third one away!)

    * If memory is organized as an array of bytes, how do we access other data
      types which need more space. 

    * What are the common names for the standard container sizes used in a 64-bit computer?

    * How are negative integers represented in a computer?

    * Show the binary encoding for +42 and -42 as eight bit numbers, then show
      what you get when you add them?

    * Extend both +42 and -42 to 16 bits.

    * Basically, how are floating point numbers encoded?

