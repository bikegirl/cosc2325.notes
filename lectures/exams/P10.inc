  * The Pentium operates in two different "modes" describe them.

    * Describe basically how the Pentium isolates each program from any
      others loaded in memory at the same time.

    * What do we mean by the term "virtual memory"?

    * Draw a diagram of the RDX register in the 64-bit Pentium showing
      all the register names we can use when accessing bits in this
      register.

    * What is a "mnemonic"?

    * Why does the Pentium not support direct memory to memory
      transfers?

    * Describe basic assembly language style.

    * Show a line of assembly language that defines a 32-bit data
      container names "MyVar".

    * Show how we might set up a 10,000 word chunk of memory named
      "buffer".

    * Why is it important to set up separate data areas for initialized
      and uninitialized data?

    * What is a "literal" operand, and where can it be used in a pentium
      instruction?

    * We described the RTDCS  instruction provided by the Pentium that can be
      used in timing a program. Why does using this instruction sometimes give
      bad timing data?

    * Why do we need a reference to a "human" time source to get a
      machine to be able to perform timing of its own program?

..  vim:filetype=rst spell:



