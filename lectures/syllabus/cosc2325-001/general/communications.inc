Communications
==============

..  note::

    For most of my courses, I post lecture materials, and assignments on my
    class website. Navigate to `Roie Black's ACC Website
    <http://www.austincc.edu/rblack>`_ to find links for your class. For some of
    my courses lecture materials and assignments will be found on Blackboard.
    Grades for all classes will be posted on Blackboard.

The ACC online Blackboard system  (`Blackboard <http://acconline.austincc.edu/>`_)
and the ACC e-mail accounts will be used as the official communication system
during this semester.  Lecture notes, handouts, changes to course schedule or
assignments and your grades will be posted on Blackboard and all email
communication will be via the ACC e-mail accounts.  All students are expected
to check both Blackboard and their ACC e-mail accounts on a regular basis.  For
information on how to log onto Blackboard and ACC e-mail, please visit the
following sites:

    * `Student Support <http://irt.austincc.edu/blackboard/StudentSupport.php>`_

    * `Student Email <http://www.austincc.edu/google/>`_

