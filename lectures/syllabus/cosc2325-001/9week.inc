..  csv-table::
    :header: Week, Dates,Topic,Lab,Reading
    :widths: 6, 10, 25, 10, 10

    1,5/31,Course Introduction,Lab Setup,1.1-1.5
    ,,History Lesson,,Notes
    ,5/1,Orientation Exam,HW1,Syllabus
    ,,A Peek at Assembly,Lab1,Notes
    ,,Von Neumann Machines,,Notes
    ,,Performance,HW2,1.6
    2,6/6,Number systems,HW3,
    ,,Machine Language,Lab2,
    ,,Coding Instructions,,
    ,6/8,Decisions,,
    ,,Procedures,,
    ,,Input/Output,,
    3,6/13,Doing Math,Lab3,
    ,6/14,Review for Exam 1,,
    4,6/20, **Exam 1**, **Ex1 Lab**,
    ,,Processor Design,,
    ,6/22,Hardware Design Languages,,
    ,,Pipelining,Lab4,
    5,6/27,Pentium&ARM
    ,,Assembly Language,,
    ,6/29,Memory Heirarchy,Lab5,
    ,,Caches,,
    6,7/4,**Independence Day**,,
    ,7/6,Virtualization,Lab6,
    ,,Group Project 1 Demos,,
    ,,Review for Exam 2,,
    7,7/11,**Exam 2**, **EX2 Lab**,
    ,,Embedded Systems,Lab7,
    ,7/13,Timers,,
    8,7/18,Pulse Width Modulation,,
    ,7/19,Motor Control,Lab8,
    9,7/25,Interrupts,,
    ,7/27,Multitasking,Lab9,
    10,8/1,**Group Project 2 Demos**,,	
 	 

