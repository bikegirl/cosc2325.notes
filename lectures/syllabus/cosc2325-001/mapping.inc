..  |W01|   replace::   1
..  |D01|   replace::   5/30
..  |T01|   replace::   Intro, Getting Started (Lecture1)
..  |R01|   replace::   Syllabus, Ch1.1-1.5
..  |L01|   replace::   Exam 0, Week1Labs
..  |G01|   replace::   6/4 

..  |W02|   replace::   2
..  |D02|   replace::   6/5 
..  |T02|   replace::   Von Neumann Machines, Performance (Lecture2_)
..  |R02|   replace::   Ch 1.6-1.10
..  |L02|   replace::   Week2Labs_
..  |G02|   replace::   6/11

..  |W03|   replace::   3
..  |D03|   replace::   6/12
..  |T03|   replace::   Machine Language, Number Systems (Lecture3_)
..  |R03|   replace::   Ch 2.1-2.5
..  |L03|   replace::   Week3Labs_
..  |G03|   replace::   6/18

..  |W04|   replace::   4
..  |D04|   replace::   6/19
..  |T04|   replace::   Boolean Algebra, Digital Components (Lecture4_)
..  |R04|   replace::   Ch 2.6-2.9
..  |L04|   replace::   Week4Labs_
..  |G04|   replace::   6/25

..  |W05|   replace::   5
..  |D05|   replace::   6/26
..  |T05|   replace::   CPU Simulator, **Exam 1 Review** (Lecture5_)
..  |R05|   replace::   App A-D, Ch 3.1-3.5
..  |L05|   replace::   Week5Labs_
..  |G05|   replace::   7/2 

..  |W06|   replace::   6
..  |D06|   replace::   7/3 
..  |T06|   replace::   **Exam 1**
..  |R06|   replace::   Lecture Notes
..  |L06|   replace::   Week6Labs_
..  |G06|   replace::   7/9 

..  |W07|   replace::   7
..  |D07|   replace::   7/10
..  |T07|   replace::   Instruction Set Architecture (Lecture6_)
..  |R07|   replace::   Ch 4.5-4.8, notes
..  |L07|   replace::   Week7Labs_
..  |G07|   replace::   7/16

..  |W08|   replace::   8
..  |D08|   replace::   7/17
..  |T08|   replace::   Pentium Processor (Lecture7_)
..  |R08|   replace::   Notes
..  |L08|   replace::   Week8Labs_
..  |G08|   replace::   7/23

..  |W09|   replace::   9
..  |D09|   replace::   7/24
..  |T09|   replace::   Memory Heirarchy, Caches, Virtual Memory (Lecture8_)
..  |R09|   replace::   Ch 5.1-5.5, 5.7
..  |L09|   replace::   Week9Labs_
..  |G09|   replace::   7/30

..  |W10|   replace::   10
..  |D10|   replace::   7/31
..  |T10|   replace::   Virtualization, Multi-core 
..  |R10|   replace::   Ch 5.6, 6.5
..  |L10|   replace::   Week10Labs_
..  |G10|   replace::   8/1

..  |LD1|   replace::   8/1
..  |LD2|   replace::   **Last day to submit work for grading**

